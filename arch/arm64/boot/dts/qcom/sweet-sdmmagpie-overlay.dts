 /*
 * Copyright (c) 2018, The Linux Foundation. All rights reserved.
 * Copyright (C) 2021 XiaoMi, Inc.
 *
 * This program is free software; you can redistribute it and/or modify
 * it under the terms of the GNU General Public License version 2.
 */

/dts-v1/;
/plugin/;
#define SWEET_DSI_HOST_UNIQUE_NODE

#include <dt-bindings/interrupt-controller/arm-gic.h>
#include <dt-bindings/clock/qcom,camcc-sdmmagpie.h>

/ {
        model = "SWEET";
        compatible = "qcom,sdmmagpie-qrd", "qcom,sdmmagpie", "qcom,qrd";
        qcom,msm-id = <365 0x0>;
        qcom,board-id = <46 0>;
};

#include "sweet-audio-overlay.dtsi"
#include "sweet-sdmmagpie.dtsi"
#include "sweet-nfc-overlay.dtsi"

&dsi_sw43404_amoled_video_display {
        qcom,dsi-display-active;
};
